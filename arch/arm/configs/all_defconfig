## arch/arm/configs/all_defconfig
```kconfig
# XATTR configs
CONFIG_DEFAULT_SECURITY_SELINUX=y
CONFIG_SDCARD_FS_XATTR=y
CONFIG_ECRYPT_FS_VIRTUAL_FAT_XATTR=y
CONFIG_FAT_VIRTUAL_XATTR=y
CONFIG_EXFAT_VIRTUAL_XATTR=y
CONFIG_FAT_VIRTUAL_XATTR_SELINUX_LABEL="u:object_r:sdcard_external:s0"
CONFIG_SEC_SELINUX=y

CONFIG_PROFILING=y
CONFIG_UID_CPUTIME=y
CONFIG_CRYPTO_AES_ARM=y

# CONFIG_SEC_RESTRICT_ROOTING is not set
# CONFIG_SEC_RESTRICT_SETUID is not set
# CONFIG_SEC_RESTRICT_FORK is not set
# CONFIG_SEC_RESTRICT_ROOTING_LOG is not set

CONFIG_DEFERRED_INITCALLS=y

CONFIG_TIMA=y
CONFIG_SEC_DEBUG_TIMA_LOG=y
CONFIG_TZ_ICCC=y

CONFIG_PRINTK_CORE_NUM=y

CONFIG_NETFILTER_XT_TARGET_IDLETIMER=y
CONFIG_NETWORK_FILESYSTEMS=y
CONFIG_MAGIC_SYSRQ=y

CONFIG_INET_AH=y
CONFIG_INET_IPCOMP=y
CONFIG_INET_XFRM_MODE_BEET=y
CONFIG_INET_XFRM_MODE_TUNNEL=y
CONFIG_INET_XFRM_TUNNEL=y

CONFIG_DEVKMEM=n
CONFIG_DEVMEM=n

CONFIG_USB_ARMLINUX=y
CONFIG_USB_BELKIN=y
CONFIG_USB_GSPCA=y
CONFIG_USB_NET_AX8817X=y
CONFIG_USB_NET_CDCETHER=y
CONFIG_USB_NET_CDC_NCM=y
CONFIG_USB_NET_CDC_SUBSET=y
CONFIG_USB_NET_NET1080=y
CONFIG_USB_NET_SMSC75XX=y
CONFIG_USB_NET_SMSC95XX=y
CONFIG_USB_NET_ZAURUS=y
CONFIG_USB_RTL8150=y
CONFIG_USB_USBNET=y

CONFIG_PGTABLE_MAPPING=y
CONFIG_FRONTSWAP=y
CONFIG_VNSWAP=y
CONFIG_SWAP=y
CONFIG_ZSMALLOC_NEW=y
CONFIG_ZSWAP=y
CONFIG_TIGHT_PGDAT_BALANCE=y
CONFIG_DIRECT_RECLAIM_FILE_PAGES_ONLY=y
CONFIG_FIX_INACTIVE_RATIO=y

CONFIG_SEC_DEBUG_LMK_MEMINFO=y
CONFIG_SEC_LOG_LAST_KMSG=y
CONFIG_SEC_OOM_KILLER=y

CONFIG_CRYPTO_ANSI_CPRNG=y
CONFIG_CRYPTO_CTR=y
CONFIG_CRYPTO_GCM=y
CONFIG_CRYPTO_GF128MUL=y
CONFIG_CRYPTO_GHASH=y
CONFIG_CRYPTO_RNG=y
CONFIG_CRYPTO_SEQIV=y

CONFIG_MODULES=n

CONFIG_REGMAP_IRQ=y
```

## drivers/sensorhub/stm/Kconfig
```kconfig
#
# sensor drivers configuration
#

config SENSORS_SYSFS
	tristate "Sensors sysfs"
	help
	  Support sysfs for sensors.
	  If you say yes here you get sysfs support for
	  sensor factory test.
	  To compile this driver as a module, choose M here: the
	  module will be called sensors_core.

config SENSORS_SSP
	tristate "Sensors ssp"
	default n
	depends on SPI
	help
	  ssp driver for sensor hub.
	  If you say yes here you get ssp support for
	  sensor hub.
	  To compile this driver as a module, choose M here: the
	  module will be called ssp.

config SENSORS_SSP_STM
	tristate "Sensors ssp stm"
	default n
	depends on SPI
	help
	  ssp driver for sensor hub.
	  If you say yes here you get ssp support for
	  sensor hub.
	  To compile this driver as a module, choose M here: the
	  module will be called ssp.

config SENSORS_SSP_SENSORHUB
	tristate "Sensors ssp sensorhub"
	default n
	depends on SPI
	help
	  ssp sensor hub driver for sensor hub.
	  If you say yes here you get ssp support for
	  sensor hub.
	  To compile this driver as a module, choose M here: the
	  module will be called ssp.

source "drivers/sensorhub/stm/factory/Kconfig"
```
